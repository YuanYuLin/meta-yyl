## meta-home/conf/layer.conf
```bitbake
# We have a conf and classes directory, add to BBPATH
BBPATH .= ":${LAYERDIR}"

# We have recipes-* directories, add to BBFILES
BBFILES += "${LAYERDIR}/recipes-*/*/*.bb \
            ${LAYERDIR}/recipes-*/*/*.bbappend"

BBFILE_COLLECTIONS += "home-layer"
BBFILE_PATTERN_home-layer := "^${LAYERDIR}/"
LAYERSERIES_COMPAT_home-layer = "langdale mickledore"
```

## meta-home/conf/machine/home.conf
```bitbake
KMACHINE = "aspeed"
KERNEL_DEVICETREE = "${KMACHINE}-bmc-${MACHINE}.dtb"

require conf/machine/include/ast2500.inc
require conf/machine/include/obmc-bsp-common.inc

UBOOT_MACHINE = "evb-ast2500_defconfig"

FLASH_SIZE = "32768"
```
